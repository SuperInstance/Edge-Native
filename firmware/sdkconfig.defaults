## firmware/sdkconfig.defaults
```kconfig
# NEXUS ESP32-S3 SDK Configuration Defaults
# Per specs/firmware/memory_map_and_partitions.md and claude-build/build-specification.md

# CPU
CONFIG_ESP_DEFAULT_CPU_FREQ_MHZ_240=y
CONFIG_ESP_DEFAULT_CPU_FREQ_240=y

# FreeRTOS
CONFIG_FREERTOS_HZ=1000
CONFIG_FREERTOS_CHECK_STACKOVERFLOW_CANARY=y
CONFIG_FREERTOS_MAX_PRIORITIES=25
CONFIG_FREERTOS_TIMER_TASK_STACK_DEPTH=4096

# PSRAM (Octal SPI, 8MB)
CONFIG_SPIRAM=y
CONFIG_SPIRAM_MODE_OCT=y
CONFIG_SPIRAM_SPEED_80M=y
CONFIG_SPIRAM_USE_MALLOC=y
CONFIG_SPIRAM_MALLOC_ALWAYSINTERNAL=16384

# Flash (8MB)
CONFIG_ESPTOOLPY_FLASHSIZE_8MB=y
CONFIG_PARTITION_TABLE_CUSTOM=y
CONFIG_PARTITION_TABLE_CUSTOM_FILENAME="partitions.csv"

# Heap debugging (comprehensive poisoning in debug builds)
CONFIG_HEAP_POISONING_COMPREHENSIVE=y

# Watchdog
CONFIG_ESP_TASK_WDT_EN=y
CONFIG_ESP_TASK_WDT_TIMEOUT_S=5

# UART (wire protocol on UART1)
CONFIG_ESP_CONSOLE_UART_NUM_0=y

# Security (enable for production builds)
# CONFIG_SECURE_FLASH_ENC_ENABLED=y
# CONFIG_SECURE_BOOT_V2_ENABLED=y

# NVS
CONFIG_NVS_DEFAULT_PAGE_SIZE=4096

# Compiler
CONFIG_COMPILER_OPTIMIZATION_PERF=y
CONFIG_COMPILER_WARN_WRITE_STRINGS=y
```
